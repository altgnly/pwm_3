	LIST P=16F877A
	#INCLUDE <P16F877A.INC>
	__CONFIG H'3F31'
	SAYICI1 EQU 0X20
	SAYICI2 EQU 0X21
	ORG 0X000
	GOTO ANA_METOT
	
ANA_METOT
	BANKSEL TRISA
	MOVLW 0X06
	MOVWF ADCON1
	MOVLW 0XFF
	MOVWF TRISA
	CLRF TRISC
	BANKSEL PORTA
	MOVLW 0XFF
	MOVWF PORTA
	CLRF PORTC
	
	BANKSEL CCP1CON
	MOVLW B'00001100'
	MOVWF CCP1CON
	BANKSEL CCP1CON
	
	BANKSEL CCPR1L
	MOVLW D'20'
	MOVWF CCPR1L
	BANKSEL CCPR1L
	
	BANKSEL PR2
	MOVLW D'99'
	MOVWF PR2
	BANKSEL PR2
	
	BANKSEL T2CON
	MOVLW B'00000101'	;PRE=4
	MOVWF T2CON
	BANKSEL T2CON

KONTROL
	BTFSC PORTA,0
	GOTO DUTY_ARTIR
	BTFSC PORTA,1
	GOTO DUTY_AZALT
	BTFSC PORTA,2
	GOTO PWM_SET
	BTFSC PORTA,3
	GOTO PWM_RESET
	GOTO KONTROL

DUTY_ARTIR
	MOVLW D'100'
	SUBWF CCPR1L,W
	BTFSC STATUS,Z
	GOTO KONTROL
	MOVLW D'10'
	ADDWF CCPR1L,F
	GOTO DUTY_ARTIR

DUTY_AZALT
	MOVF CCPR1L,W
	SUBLW D'0'
	BTFSC STATUS,Z
	GOTO KONTROL
	MOVLW D'10'
	SUBWF CCPR1L,F
	GOTO DUTY_AZALT

PWM_SET

PWM_RESET

END